## linux/fs/winefs/Kconfig
```kconfig
config WINEFS
	tristate "WineFS"
	depends on FS_DAX 
	select CRC16
	help
	   If your system has a block of fast (comparable in access speed to
	   system memory) and non-volatile byte-addressable memory and you wish to
	   mount a light-weight, full-featured, and space-efficient filesystem over
	   it, say Y here, and read <file:Documentation/filesystems/pmfs.txt>.

	   To compile this as a module,  choose M here: the module will be
	   called pmfs.

config WINEFS_XIP
	bool "Execute-in-place in WineFS"
	depends on PMFS && BLOCK
	help
	   Say Y here to enable XIP feature of WineFS.

config WINEFS_WRITE_PROTECT
	bool "WINEFS write protection"
	depends on WINEFS && MMU && HAVE_SET_MEMORY_RO
	default y
	help
	   Say Y here to enable the write protect feature of WineFS.

config WINEFS_TEST
	bool
	depends on WINEFS

config WINEFS_TEST_MODULE
	tristate "WINEFS Test"
	depends on WINEFS && WINEFS_WRITE_PROTECT && m
	select WINEFS_TEST
	help
	  Say Y here to build a simple module to test the protection of
	  PMFS. The module will be called pmfs_test.
```
